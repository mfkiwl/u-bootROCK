// SPDX-License-Identifier: (GPL-2.0+ OR MIT)
/*
 * Copyright (c) 2022 Edgeble AI Technologies Pvt. Ltd.
 */

#include "rv1126-u-boot.dtsi"

&sdio {
	status = "disabled";
};

&usb_host0_ehci {
	clocks = <&cru HCLK_USBHOST>, <&cru HCLK_USBHOST_ARB>;
};

&usb_host0_ohci {
	clocks = <&cru HCLK_USBHOST>, <&cru HCLK_USBHOST_ARB>;
};
