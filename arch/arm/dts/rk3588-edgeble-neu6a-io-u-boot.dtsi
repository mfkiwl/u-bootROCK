// SPDX-License-Identifier: (GPL-2.0+ OR MIT)
/*
 * Copyright (c) 2022 Edgeble AI Technologies Pvt. Ltd.
 */

#include "rk3588-u-boot.dtsi"

/ {
	aliases {
		mmc0 = &sdhci;
	};

	chosen {
		stdout-path = &uart2;
		u-boot,spl-boot-order = &sdhci;
	};
};

&sdmmc {
	bus-width = <4>;
	u-boot,dm-spl;
	status = "okay";
};
