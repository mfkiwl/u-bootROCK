## arch/arm/mach-rockchip/rv1126/Kconfig
```kconfig
if ROCKCHIP_RV1126

config TARGET_RV1126_ECM0
	bool "Edgeble AI Edge Compute Module 0 SoM"
	help
	  Edge Compute Module 0 is a 96boards SoM-CB compute module based
	  on Rockchip RV1126 from Edgeble AI.

	  ECM0-Carrier:
	  Edge Compute Module 0 needs to mount on top of this Carrier board
          for creating Edge Compute Module 0 Carrier platform.

config SOC_SPECIFIC_OPTIONS # dummy
	def_bool y
	select HAS_CUSTOM_SYS_INIT_SP_ADDR

config ROCKCHIP_BOOT_MODE_REG
	default 0xfe020200

config ROCKCHIP_STIMER_BASE
	default 0xff670020

config SYS_SOC
	default "rv1126"

config CUSTOM_SYS_INIT_SP_ADDR
	default 0x800000

config SPL_STACK
	default 0x600000

config SPL_STACK_R_ADDR
	default 0x800000

config TPL_LDSCRIPT
	default "arch/arm/mach-rockchip/u-boot-tpl.lds"

config TPL_STACK
        default 0xff718000

config TPL_SYS_MALLOC_F_LEN
	default 0x2000

config TPL_TEXT_BASE
	default 0xff701000

config SYS_MALLOC_F_LEN
	default 0x2000

config SYS_TEXT_BASE
	default 0x600000

source board/edgeble/edge-compute-module-0/Kconfig

endif
```

## board/edgeble/edge-compute-module-0/Kconfig
```kconfig
if TARGET_RV1126_ECM0

config SYS_BOARD
	default "edge-compute-module-0"

config SYS_VENDOR
	default "edgeble"

config SYS_CONFIG_NAME
	default "edge-compute-module-0"

config BOARD_SPECIFIC_OPTIONS # dummy
	def_bool y
	select RAM_ROCKCHIP_LPDDR4

endif
```
